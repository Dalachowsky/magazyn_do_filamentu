## software/firmware/dts/bindings/filamux/filamux,extruder.yaml
```yaml
# Copyright (c) 2021 Nordic Semiconductor ASA
# SPDX-License-Identifier: Apache-2.0

description: |
  An example sensor that reads the GPIO level defined in input-gpios. The
  purpose of this sensor is to demonstrate how to create out-of-tree drivers.

  Example definition in devicetree:

    examplesensor {
        compatible = "zephyr,examplesensor";
        input-gpios = <&gpio0 0 (GPIO_PULL_UP | GPIO_ACTIVE_LOW)>;
    };

compatible: "filamux,extruder"

include: base.yaml

properties:
  dir-gpio:
    type: phandle-array
    required: true
    specifier-space: gpio
  step-gpio:
    type: phandle-array
    required: true
    specifier-space: gpio
  timer:
    type: phandle
```

## software/firmware/dts/bindings/filamux/filamux,io.yaml
```yaml
# Copyright (c) 2021 Nordic Semiconductor ASA
# SPDX-License-Identifier: Apache-2.0

description: |
  An example sensor that reads the GPIO level defined in input-gpios. The
  purpose of this sensor is to demonstrate how to create out-of-tree drivers.

  Example definition in devicetree:

    examplesensor {
        compatible = "zephyr,examplesensor";
        input-gpios = <&gpio0 0 (GPIO_PULL_UP | GPIO_ACTIVE_LOW)>;
    };

compatible: "filamux,io"

include: base.yaml

child-binding:
  properties:
    in-gpio:
      type: phandle-array
      required: true
      specifier-space: gpio
    mid-gpio:
      type: phandle-array
      required: true
      specifier-space: gpio
    out-gpio:
      type: phandle-array
      required: true
      specifier-space: gpio

properties:
  mux-out-gpio:
    type: phandle-array
    required: true
    specifier-space: gpio
  mux-common-gpio:
    type: phandle-array
    required: true
    specifier-space: gpio
```

## software/firmware/lib/filamux-proto/Kconfig
```kconfig
# Copyright (c) 2021, Legrand North America, LLC.
# SPDX-License-Identifier: Apache-2.0

config FILAMUX_PROTO_LIB
	bool "filamux-proto Support"
	help
	  This option enables the filamux-proto library
```
